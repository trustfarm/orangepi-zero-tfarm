## OrangePi-Kernel/linux-3.4/drivers/net/wireless/rtl8189fs/Kconfig
```kconfig
config RTL8189FS
	tristate "Realtek 8189F SDIO WiFi"
	depends on USB
	select WIRELESS_EXT
	select WEXT_PRIV
	---help---
	  Help message of RTL8189FS
```

## OrangePi-Kernel/linux-3.4/drivers/net/wireless/ssv6xxx/Kconfig
```kconfig
config SSV6XXX
	tristate "ssv6XXX Wireless driver"
	depends on MAC80211 && MMC
	---help---
		Enable SouthSV 6XXX WLAN kernel driver.
```
